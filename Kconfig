## Kconfig
```kconfig
# SPDX-License-Identifier: MIT

DT_COMPAT_CODEKEEB_BATTERY_NRF_VDDH_CURVE := codekeeb,battery-nrf-vddh-curve

config CODEKEEB_BATTERY_NRF_VDDH_CURVE
    bool
    default $(dt_compat_enabled,$(DT_COMPAT_CODEKEEB_BATTERY_NRF_VDDH_CURVE))
    select ADC
    select ZMK_BATTERY
    depends on SENSOR
    help
      nRF52 VDDH battery driver using a real LiPo discharge curve instead of
      ZMK's linear 4.20V -> 3.45V approximation.

config SOFLE_ART_INTERVAL_MS
    int "Right OLED: milliseconds between Hammerbeam art images"
    default 10000

config SOFLE_ART_INVERTED
    bool "Right OLED: invert Hammerbeam art colors"
```

## boards/shields/Sofle/Kconfig.shield
```kconfig
# Copyright (c) 2020 Pete Johanson
# SPDX-License-Identifier: MIT

config SHIELD_SOFLE_L
    def_bool $(shields_list_contains,Sofle_L)

config SHIELD_SOFLE_R
    def_bool $(shields_list_contains,Sofle_R)

config SHIELD_SOFLE_L_NATIVE
    def_bool $(shields_list_contains,Sofle_L_native)

config SHIELD_SOFLE_R_NATIVE
    def_bool $(shields_list_contains,Sofle_R_native)
```
